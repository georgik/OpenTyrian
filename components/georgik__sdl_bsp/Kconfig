## components/georgik__sdl_bsp/Kconfig
```kconfig
menu "ESP-BSP SDL Configuration"

    choice SDL_BSP_SELECTION
        prompt "Select Target Board"
        default SDL_BSP_ESP_BOX_3
        help
            Select the target board for your SDL application.
            This determines which ESP-BSP will be used and configures
            the appropriate display, touch, and other hardware settings.

        config SDL_BSP_ESP_BOX_3
            bool "ESP-Box-3"
            help
                ESP-Box-3 development board with ESP32-S3, LCD display and touch.

        config SDL_BSP_ESP32_C6_DEVKIT
            bool "ESP32-C6 DevKit with ILI9341 Display"
            help
                ESP32-C6 development board with external ILI9341 LCD display.

        config SDL_BSP_M5STACK_CORE_S3
            bool "M5Stack Core S3"
            help
                M5Stack Core S3 with ESP32-S3 and built-in display.

        config SDL_BSP_M5_ATOM_S3
            bool "M5 Atom S3"
            help
                M5 Atom S3 with ESP32-S3 and 240x240 round LCD display.

        config SDL_BSP_ESP32_C3_LCDKIT
            bool "ESP32-C3-LCDkit"
            help
                ESP32-C3-LCDkit development board with LCD display.

        config SDL_BSP_ESP32_P4_FUNCTION_EV
            bool "ESP32-P4 Function EV Board"
            help
                ESP32-P4 Function Evaluation Board with advanced display capabilities.

        config SDL_BSP_ESP32_S3_LCD_EV_BOARD
            bool "ESP32-S3-LCD-EV-Board"
            help
                ESP32-S3-LCD-EV-Board development board for evaluating ESP32-S3 screen interactive applications.

        config SDL_BSP_M5STACK_TAB5
            bool "M5Stack Tab5 (Experimental)"
            help
                M5Stack Tab5 ESP32-P4 tablet with 5-inch 720×1280 MIPI-DSI display, 
                GT911 touch controller, and high-performance hardware. 
                Requires 200MHz PSRAM for proper operation.

    endchoice

    config NAME
        string
        default "esp-box-3_noglib" if SDL_BSP_ESP_BOX_3
        default "esp-box_noglib" if SDL_BSP_ESP_BOX
        default "esp_bsp_generic" if SDL_BSP_ESP32_C6_DEVKIT
        default "m5stack_core_s3_noglib" if SDL_BSP_M5STACK_CORE_S3
        default "m5_atom_s3" if SDL_BSP_M5_ATOM_S3
        default "esp32_c3_lcdkit" if SDL_BSP_ESP32_C3_LCDKIT
        default "esp32_p4_function_ev_board_noglib" if SDL_BSP_ESP32_P4_FUNCTION_EV
        default "esp32_s3_lcd_ev_board_noglib" if SDL_BSP_ESP32_S3_LCD_EV_BOARD
        default "m5stack_tab5_noglib" if SDL_BSP_M5STACK_TAB5

    config SDL_BSP_SDKCONFIG_SUFFIX
        string
        default "esp-box-3" if SDL_BSP_ESP_BOX_3
        default "esp-box" if SDL_BSP_ESP_BOX
        default "esp32_c6_devkit" if SDL_BSP_ESP32_C6_DEVKIT
        default "m5stack_core_s3" if SDL_BSP_M5STACK_CORE_S3
        default "m5_atom_s3" if SDL_BSP_M5_ATOM_S3
        default "esp32_c3_lcdkit" if SDL_BSP_ESP32_C3_LCDKIT
        default "esp32_p4_function_ev_board" if SDL_BSP_ESP32_P4_FUNCTION_EV
        default "esp32_s3_lcd_ev_board" if SDL_BSP_ESP32_S3_LCD_EV_BOARD
        default "m5stack_tab5" if SDL_BSP_M5STACK_TAB5

    config SDL_BSP_TOUCH_ENABLE
        bool "Enable Touch Support"
        default n
        help
            Enable touch interface support for boards that have touch capabilities.
            This is disabled by default since some boards may have complex touch
            initialization that could interfere with the application.
            Only enable this if your application needs touch input.

endmenu
```

## sdkconfig.defaults.m5stack_tab5
```kconfig
# M5Stack Tab5 ESP32-P4 Configuration
# - 5-inch 1280x720 IPS display via MIPI-DSI
# - GT911 touch controller
# - 16MB Flash, 32MB PSRAM
# - ESP32-P4 dual-core RISC-V

# Board selection
CONFIG_SDL_BSP_M5STACK_TAB5=y

CONFIG_IDF_TARGET="esp32p4"
CONFIG_ESPTOOLPY_FLASHSIZE_16MB=y
CONFIG_ESPTOOLPY_FLASHMODE_QIO=y
CONFIG_COMPILER_OPTIMIZATION_PERF=y
CONFIG_FREERTOS_HZ=1000

# PSRAM Configuration for ESP32-P4
CONFIG_SPIRAM=y
CONFIG_SPIRAM_MODE_HEX=y
CONFIG_SPIRAM_SPEED_200M=y
CONFIG_SPIRAM_FETCH_INSTRUCTIONS=y
CONFIG_SPIRAM_RODATA=y
CONFIG_SPIRAM_ALLOW_BSS_SEG_EXTERNAL_MEMORY=y

# ESP32-P4 specific features
CONFIG_IDF_EXPERIMENTAL_FEATURES=y

# Required for TTF rendering if it happens in main task
CONFIG_ESP_MAIN_TASK_STACK_SIZE=32000

# Panic behavior - halt and print stacktrace instead of rebooting
CONFIG_ESP_SYSTEM_PANIC_PRINT_HALT=y

# BSP configuration for M5Stack Tab5
CONFIG_ESPTOOLPY_FLASHSIZE_16MB=y
CONFIG_PARTITION_TABLE_CUSTOM=y
CONFIG_PARTITION_TABLE_CUSTOM_FILENAME="partitions.csv"

# OpenTyrian Configuration for M5Stack Tab5
# Use 90-degree rotation with 3x scaling handled by PPA hardware (maximizes screen usage)
CONFIG_OPENTYRIAN_SCALE_AUTO=n
CONFIG_OPENTYRIAN_SCALE_FACTOR_INT=3
CONFIG_OPENTYRIAN_ENABLE_HARDWARE_ACCELERATION=y
CONFIG_OPENTYRIAN_ROTATION_90=y
CONFIG_OPENTYRIAN_DEBUG_SCALING=y
CONFIG_OPENTYRIAN_ENABLE_MEMORY_CHECK=n
```
